/dts-v1/;

#include "vr9_arcadyan_vgv7510kw22-nor.dtsi"

/ {
	compatible = "arcadyan,vgv7510kw22-nor-smp", "arcadyan,vgv7510kw22", "lantiq,xway", "lantiq,vr9";
	model = "o2 Box 6431";
	
	chosen {
		bootargs = "console=ttyLTQ0,115200";
	};
};
