/dts-v1/;

#include "vr9_arcadyan_vgv7510kw22-nor.dtsi"

/ {
	compatible = "arcadyan,vgv7510kw22-nor-vpe", "arcadyan,vgv7510kw22", "lantiq,xway", "lantiq,vr9";
	model = "o2 Box 6431";
	
	chosen {
		bootargs = "console=ttyLTQ0,115200 mem=62M vpe1_load_addr=0x83e00000 vpe1_mem=2M maxvpes=1 maxtcs=1 nosmp";
	};
};
